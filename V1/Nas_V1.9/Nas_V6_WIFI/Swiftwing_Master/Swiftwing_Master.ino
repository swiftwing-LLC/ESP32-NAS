/*
  Swiftwing NAS V1.3.0 Owner Approved Accounts

  Role:
    - Control / Login / NAS Web UI only
    - Discovers Storage Node 1 and Storage Node 2
 - Tracks ESP32-C3 DNS and ESP32 Monitor
    - Announces current Master IP to C3 DNS
    - DOES NOT store user files locally

  UI:
    /        = NAS file manager
    /status  = system/node monitoring page

  Board: ESP32
*/

#include <WiFi.h>
#include <WebServer.h>
#include <WiFiUdp.h>
#include <Preferences.h>
#include <stdlib.h>
#include <string.h>
#include <mbedtls/pkcs5.h>
#include "account_store_types.h"

// =====================================================
// CONFIG
// =====================================================

const char* DEFAULT_WIFI_SSID     = "BaBaWu";
const char* DEFAULT_WIFI_PASSWORD = "95042700Wu$";

const char* UI_USERNAME   = "admin";
const char* UI_PASSWORD   = "88888888";

// Must be exactly the same in Master, Node 1 and Node 2.
const char* NODE_API_KEY  = "BaBaWu";

const char* NAS_DOMAIN    = "swiftwingnas.tplinkdns.com";
const char* UI_BUILD      = "V1.2.9 COBALT MOTION FAN";
const uint8_t MAX_NAS_USERS = 16;
const uint8_t MAX_PENDING_NAS_USERS = 8;
const unsigned int USER_PASSWORD_ITERATIONS = 12000;

// =====================================================
// Network protocol
// =====================================================

const uint16_t HTTP_PORT              = 80;
const uint16_t STORAGE_DISCOVERY_PORT = 4210;
const uint16_t MASTER_ANNOUNCE_PORT   = 4211;
const uint16_t MASTER_LOCAL_PORT      = 4212;
const uint16_t DNS_STATUS_PORT        = 4213;
const uint16_t MONITOR_STATUS_PORT    = 4214;
const uint16_t MONITOR_FAN_CONTROL_PORT = 4216;

const unsigned long DISCOVERY_INTERVAL_MS = 3000;
const unsigned long MASTER_ANNOUNCE_MS    = 3000;
const unsigned long NODE_TIMEOUT_MS       = 12000;
const unsigned long SERVICE_TIMEOUT_MS    = 15000;

WebServer server(HTTP_PORT);

// =====================================================
// Forward declarations
// =====================================================

String jsonEscape(String s);
bool isAuthenticated();
int currentSessionSlot();
bool isAdminAuthenticated();

WiFiUDP storageUDP;
WiFiUDP masterAnnounceUDP;
WiFiUDP dnsStatusUDP;
WiFiUDP monitorStatusUDP;


// =====================================================
// Wi-Fi management / cluster provisioning
// =====================================================

const char* SWIFTWING_SETUP_SSID = "Swiftwing-Bridge";
const char* SWIFTWING_SETUP_PASS = "swiftwing-setup";
const char* WIFI_SYNC_KEY         = "SWIFTWING_WIFI_V1";
const uint16_t WIFI_SYNC_PORT     = 4220;
const uint16_t WIFI_SYNC_LOCAL_PORT = 4221;

Preferences wifiPrefs;
Preferences userPrefs;
WiFiUDP wifiSyncUDP;

String configuredSSID = "";
String configuredPass = "";
bool provisioningMode = false;
unsigned long wifiRestartAt = 0;
unsigned long lastReconnectAttempt = 0;

String hexEncode(const String &text) {
  const char *hex = "0123456789ABCDEF";
  String out;
  out.reserve(text.length() * 2);

  for (unsigned int i = 0; i < text.length(); i++) {
    uint8_t c = (uint8_t)text[i];
    out += hex[(c >> 4) & 0x0F];
    out += hex[c & 0x0F];
  }

  return out;
}

bool loadMasterWiFi() {
  wifiPrefs.begin("swiftwifi", true);
  configuredSSID = wifiPrefs.getString("ssid", "");
  configuredPass = wifiPrefs.getString("pass", "");
  wifiPrefs.end();
  return configuredSSID.length() > 0;
}

void saveMasterWiFi(const String &ssid, const String &pass) {
  wifiPrefs.begin("swiftwifi", false);
  wifiPrefs.putString("ssid", ssid);
  wifiPrefs.putString("pass", pass);
  wifiPrefs.end();
  configuredSSID = ssid;
  configuredPass = pass;
}

bool waitForMasterWiFi(unsigned long timeoutMs) {
  unsigned long start = millis();
  while (WiFi.status() != WL_CONNECTED && millis() - start < timeoutMs) {
    delay(250);
  }
  return WiFi.status() == WL_CONNECTED;
}

void startSwiftwingBridge() {
  WiFi.mode(WIFI_AP_STA);
  WiFi.setSleep(false);

  if (!WiFi.softAP(SWIFTWING_SETUP_SSID, SWIFTWING_SETUP_PASS, 1, 0, 8)) {
    Serial.println("Swiftwing-Bridge AP start failed");
  } else {
    Serial.print("Swiftwing-Bridge: ");
    Serial.println(WiFi.softAPIP());
  }
}

void connectWiFi() {
  startSwiftwingBridge();

  bool connected = false;
  bool hadSaved = loadMasterWiFi();

  // First try the saved network, if there is one.
  if (hadSaved) {
    Serial.print("Connecting saved WiFi: ");
    Serial.println(configuredSSID);

    WiFi.begin(
      configuredSSID.c_str(),
      configuredPass.c_str()
    );

    connected = waitForMasterWiFi(8000);
  }

  // Always keep the known home WiFi as a built-in fallback.
  // This makes reflashing/NVS changes much less fragile.
  if (!connected) {
    Serial.print("Trying built-in home WiFi: ");
    Serial.println(DEFAULT_WIFI_SSID);

    WiFi.disconnect();
    delay(150);

    configuredSSID = DEFAULT_WIFI_SSID;
    configuredPass = DEFAULT_WIFI_PASSWORD;

    WiFi.begin(
      DEFAULT_WIFI_SSID,
      DEFAULT_WIFI_PASSWORD
    );

    connected = waitForMasterWiFi(12000);

    if (connected) {
      saveMasterWiFi(
        DEFAULT_WIFI_SSID,
        DEFAULT_WIFI_PASSWORD
      );
    }
  }

  provisioningMode = !connected;

  if (connected) {
    Serial.print("Master WiFi: ");
    Serial.println(WiFi.SSID());
    Serial.print("Master IP: ");
    Serial.println(WiFi.localIP());
  } else {
    Serial.println("Home WiFi not connected.");
    Serial.println("Open http://192.168.4.1 and choose WiFi.");
  }
}

void maintainMasterWiFi() {
  if (WiFi.status() == WL_CONNECTED) {
    provisioningMode = false;
    return;
  }

  if (configuredSSID.length() == 0) {
    provisioningMode = true;
    return;
  }

  unsigned long now = millis();
  if (now - lastReconnectAttempt < 10000) return;

  lastReconnectAttempt = now;
  WiFi.begin(configuredSSID.c_str(), configuredPass.c_str());
}

void sendWiFiPacketTo(IPAddress target, const String &packet) {
  wifiSyncUDP.beginPacket(target, WIFI_SYNC_PORT);
  wifiSyncUDP.print(packet);
  wifiSyncUDP.endPacket();
}

void broadcastWiFiConfig(const String &ssid, const String &pass) {
  String packet =
    String("SWIFTWING_WIFI|") +
    WIFI_SYNC_KEY + "|" +
    hexEncode(ssid) + "|" +
    hexEncode(pass);

  // Send several times so Node1 / Node2 / C3 / Monitor all have a chance to receive it.
  for (int i = 0; i < 5; i++) {
    sendWiFiPacketTo(IPAddress(255, 255, 255, 255), packet);
    sendWiFiPacketTo(IPAddress(192, 168, 4, 255), packet);
    delay(80);
  }
}

bool wifiAdminAllowed() {
  return provisioningMode || isAdminAuthenticated();
}

void handleWiFiStatus() {
  if (!wifiAdminAllowed()) {
    server.send(401, "application/json", "{\"error\":\"unauthorized\"}");
    return;
  }

  String json = "{";
  json += "\"connected\":" + String(WiFi.status() == WL_CONNECTED ? "true" : "false") + ",";
  json += "\"ssid\":\"" + jsonEscape(WiFi.status() == WL_CONNECTED ? WiFi.SSID() : String("")) + "\",";
  json += "\"ip\":\"" + (WiFi.status() == WL_CONNECTED ? WiFi.localIP().toString() : String("")) + "\",";
  json += "\"rssi\":" + String(WiFi.status() == WL_CONNECTED ? WiFi.RSSI() : 0) + ",";
  json += "\"bridgeIp\":\"" + WiFi.softAPIP().toString() + "\"";
  json += "}";

  server.sendHeader("Cache-Control", "no-store");
  server.send(200, "application/json", json);
}

void handleWiFiScan() {
  if (!wifiAdminAllowed()) {
    server.send(401, "application/json", "{\"error\":\"unauthorized\"}");
    return;
  }

  int n = WiFi.scanNetworks(false, true);
  String json = "{\"networks\":[";
  bool first = true;

  for (int i = 0; i < n; i++) {
    String ssid = WiFi.SSID(i);
    if (ssid.length() == 0) continue;

    if (!first) json += ",";
    first = false;

    json += "{";
    json += "\"ssid\":\"" + jsonEscape(ssid) + "\",";
    json += "\"rssi\":" + String(WiFi.RSSI(i)) + ",";
    json += "\"open\":" + String(WiFi.encryptionType(i) == WIFI_AUTH_OPEN ? "true" : "false");
    json += "}";
  }

  json += "]}";
  WiFi.scanDelete();

  server.sendHeader("Cache-Control", "no-store");
  server.send(200, "application/json", json);
}

void handleWiFiApply() {
  if (!wifiAdminAllowed()) {
    server.send(401, "application/json", "{\"error\":\"unauthorized\"}");
    return;
  }

  if (!server.hasArg("ssid") || !server.hasArg("password")) {
    server.send(400, "application/json", "{\"error\":\"missing fields\"}");
    return;
  }

  String ssid = server.arg("ssid");
  String pass = server.arg("password");
  ssid.trim();

  if (ssid.length() == 0 || ssid.length() > 32 || pass.length() > 64) {
    server.send(400, "application/json", "{\"error\":\"invalid WiFi credentials\"}");
    return;
  }

  // Other four boards receive and save the new Wi-Fi first.
  broadcastWiFiConfig(ssid, pass);
  saveMasterWiFi(ssid, pass);

  server.send(
    200,
    "application/json",
    "{\"ok\":true,\"message\":\"Saved. All five boards are restarting onto the selected WiFi.\"}"
  );

  wifiRestartAt = millis() + 2200;
}



// =====================================================
// Child-board Wi-Fi bootstrap over Swiftwing-Bridge
// =====================================================

void handleWiFiBootstrap() {
  if (!server.hasArg("key") || server.arg("key") != WIFI_SYNC_KEY) {
    server.send(403, "text/plain", "Forbidden");
    return;
  }

  if (configuredSSID.length() == 0) {
    loadMasterWiFi();
  }

  if (configuredSSID.length() == 0) {
    server.send(503, "text/plain", "WiFi not configured yet");
    return;
  }

  String body =
    String("SWIFTWING_BOOTSTRAP|") +
    hexEncode(configuredSSID) + "|" +
    hexEncode(configuredPass);

  server.sendHeader("Cache-Control", "no-store");
  server.send(200, "text/plain", body);
}

// =====================================================
// Sessions - allow multiple client devices
// =====================================================

const int MAX_SESSIONS = 8;

struct UserSession {
  String token;
  String username;
  bool isAdmin;
  unsigned long lastSeen;
};

UserSession sessions[MAX_SESSIONS];

// =====================================================
// Device state
// =====================================================

// Node 1 - Primary Storage
String node1Id = "NODE1";
String node1Label = "Primary Storage";
IPAddress node1IP(0, 0, 0, 0);
uint16_t node1Port = 80;
bool node1Online = false;
bool node1StorageReady = false;
uint64_t node1TotalBytes = 0;
uint64_t node1UsedBytes = 0;
uint64_t node1FreeBytes = 0;
uint32_t node1UptimeSeconds = 0;
unsigned long node1LastSeen = 0;

// Node 2 - Backup Node
String node2Id = "NODE2";
String node2Label = "Backup Node";
IPAddress node2IP(0, 0, 0, 0);
uint16_t node2Port = 80;
bool node2Online = false;
bool node2StorageReady = false;
uint64_t node2TotalBytes = 0;
uint64_t node2UsedBytes = 0;
uint64_t node2FreeBytes = 0;
uint32_t node2UptimeSeconds = 0;
unsigned long node2LastSeen = 0;

bool c3Online = false;
IPAddress c3IP(0, 0, 0, 0);
uint32_t c3Uptime = 0;
unsigned long c3LastSeen = 0;

bool monitorOnline = false;
IPAddress monitorIP(0, 0, 0, 0);
uint32_t monitorUptime = 0;
int monitorRSSI = 0;
unsigned long monitorLastSeen = 0;
String monitorBoard = "ESP32";
bool monitorFanSupported = false;
uint8_t monitorFanPercent = 0;
uint8_t monitorFanOutputPercent = 0;

unsigned long lastDiscovery = 0;
unsigned long lastMasterAnnouncement = 0;

// These pages are gzip-compressed in flash. Keep Content-Encoding: gzip on
// every route that serves them; the browser receives the original HTML.
static const uint8_t WIFI_SETUP_PAGE[] PROGMEM = {
  0x1F, 0x8B, 0x08, 0x00, 0x00, 0x00, 0x00, 0x00, 0x02, 0xFF, 0xBD, 0x5D, 0xCD, 0x96, 0xDB, 0x46, 0x76, 0xDE, 0xEB, 0x29,
  0xE0, 0x56, 0x64, 0x12, 0x36, 0xC8, 0x06, 0x40, 0x80, 0x00, 0x49, 0xB1, 0x3D, 0x92, 0xC6, 0x1E, 0x2B, 0xC7, 0x92, 0x1D,
  0xB7, 0x9C, 0xC9, 0x9C, 0x99, 0x59, 0x80, 0x44, 0xA1, 0x1B, 0x23, 0x92, 0xA0, 0x01, 0x50, 0xDD, 0x3D, 0x34, 0xCF, 0xC9,
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  0x5F, 0x8A, 0xFF, 0x57, 0xC3, 0xFF, 0x01, 0x34, 0xA7, 0x03, 0x87, 0xC3, 0x61, 0x00, 0x00,
};

static const size_t WIFI_SETUP_PAGE_LEN = sizeof(WIFI_SETUP_PAGE);


// =====================================================
// NAS MAIN PAGE
// =====================================================

static const uint8_t MAIN_PAGE[] PROGMEM = {
  0x1F, 0x8B, 0x08, 0x00, 0x00, 0x00, 0x00, 0x00, 0x02, 0xFF, 0xCD, 0xBD, 0x5B, 0x8F, 0x1B, 0x59, 0x96, 0x1E, 0xFA, 0xAE,
  0x5F, 0x11, 0x95, 0x72, 0x89, 0x64, 0x8B, 0xA4, 0x82, 0xC1, 0x3B, 0x59, 0x4C, 0x59, 0x52, 0x49, 0x5D, 0x72, 0x4B, 0x55,
  0x1A, 0xA5, 0xD4, 0x35, 0xED, 0x76, 0x63, 0x10, 0x24, 0x83, 0x99, 0x6C, 0x31, 0x49, 0x16, 0xC9, 0x94, 0x94, 0x4D, 0x25,
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  0xD2, 0xDF, 0x0B, 0xF0, 0x9E, 0xA7, 0x77, 0xFE, 0x7F, 0xB6, 0x91, 0xF3, 0x3E, 0x7A, 0x31, 0x01, 0x00,
};

static const size_t MAIN_PAGE_LEN = sizeof(MAIN_PAGE);


// =====================================================
// SYSTEM STATUS PAGE
// =====================================================

static const uint8_t STATUS_PAGE[] PROGMEM = {
  0x1F, 0x8B, 0x08, 0x00, 0x00, 0x00, 0x00, 0x00, 0x02, 0xFF, 0xCD, 0x5D, 0x69, 0x8E, 0xDB, 0x48, 0x96, 0xFE, 0xEF, 0x53,
  0xD0, 0x4A, 0x38, 0x29, 0x96, 0x29, 0x25, 0x49, 0x51, 0x12, 0x25, 0x59, 0xE9, 0x76, 0xB9, 0xCA, 0xD5, 0xC6, 0x94, 0x17,
  0x38, 0x5D, 0xD3, 0xD3, 0x68, 0xF4, 0x0F, 0x4A, 0x0C, 0x65, 0xB2, 0xAD, 0xAD, 0x49, 0x2A, 0xD3, 0x6A, 0x59, 0x40, 0x1F,
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  0xE8, 0x95, 0xAC, 0x53, 0xBB, 0x12, 0xFF, 0x4F, 0x39, 0xFF, 0x07, 0x2C, 0x43, 0xE1, 0xF2, 0x41, 0x67, 0x00, 0x00,
};

static const size_t STATUS_PAGE_LEN = sizeof(STATUS_PAGE);


// =====================================================
// Helpers
// =====================================================

String jsonEscape(String s) {
  s.replace("\\", "\\\\");
  s.replace("\"", "\\\"");
  s.replace("\r", "\\r");
  s.replace("\n", "\\n");
  return s;
}

String uint64ToString(uint64_t value) {
  char buf[32];

  snprintf(
    buf,
    sizeof(buf),
    "%llu",
    (unsigned long long)value
  );

  return String(buf);
}

String fieldAt(const String &s, int index) {
  int start = 0;
  int current = 0;

  while (true) {
    int end = s.indexOf('|', start);

    if (current == index) {
      if (end < 0) return s.substring(start);
      return s.substring(start, end);
    }

    if (end < 0) return "";

    start = end + 1;
    current++;
  }
}

String normalizeUsername(String username) {
  username.trim();
  username.toLowerCase();
  return username;
}

bool validUsername(const String &username) {
  if (username.length() < 3 || username.length() > 24) return false;

  for (size_t i = 0; i < username.length(); i++) {
    char c = username[i];
    bool alpha = c >= 'a' && c <= 'z';
    bool digit = c >= '0' && c <= '9';
    bool mark = c == '_' || c == '-' || c == '.';
    if (!alpha && !digit && !mark) return false;
    if (i == 0 && !alpha && !digit) return false;
  }

  return true;
}

bool isHexString(const String &value, size_t expectedLength) {
  if (value.length() != expectedLength) return false;
  for (size_t i = 0; i < value.length(); i++) {
    char c = value[i];
    if (!((c >= '0' && c <= '9') || (c >= 'a' && c <= 'f'))) return false;
  }
  return true;
}

bool hexToBytes(const String &hex, uint8_t *bytes, size_t byteCount) {
  if (!isHexString(hex, byteCount * 2)) return false;
  for (size_t i = 0; i < byteCount; i++) {
    char pair[3] = {hex[i * 2], hex[i * 2 + 1], '\0'};
    bytes[i] = (uint8_t)strtoul(pair, nullptr, 16);
  }
  return true;
}

String bytesToHex(const uint8_t *bytes, size_t byteCount) {
  static const char HEX_DIGITS[] = "0123456789abcdef";
  String result;
  result.reserve(byteCount * 2);
  for (size_t i = 0; i < byteCount; i++) {
    result += HEX_DIGITS[(bytes[i] >> 4) & 0x0F];
    result += HEX_DIGITS[bytes[i] & 0x0F];
  }
  return result;
}

String makeRandomSaltHex() {
  uint8_t salt[16];
  for (size_t i = 0; i < sizeof(salt); i++) {
    salt[i] = (uint8_t)(esp_random() & 0xFF);
  }
  String result = bytesToHex(salt, sizeof(salt));
  memset(salt, 0, sizeof(salt));
  return result;
}

bool derivePasswordHash(
  const String &password,
  const String &saltHex,
  String &hashHex
) {
  uint8_t salt[16];
  uint8_t derived[32];
  if (!hexToBytes(saltHex, salt, sizeof(salt))) return false;

  int result = mbedtls_pkcs5_pbkdf2_hmac_ext(
    MBEDTLS_MD_SHA256,
    (const unsigned char*)password.c_str(),
    password.length(),
    salt,
    sizeof(salt),
    USER_PASSWORD_ITERATIONS,
    sizeof(derived),
    derived
  );

  if (result == 0) hashHex = bytesToHex(derived, sizeof(derived));
  memset(salt, 0, sizeof(salt));
  memset(derived, 0, sizeof(derived));
  return result == 0;
}

bool passwordMatches(const String &password, const String &saltHex, const String &expectedHex) {
  if (!isHexString(expectedHex, 64)) return false;
  String actualHex;
  if (!derivePasswordHash(password, saltHex, actualHex)) return false;

  uint8_t diff = 0;
  for (size_t i = 0; i < expectedHex.length(); i++) {
    diff |= (uint8_t)(expectedHex[i] ^ actualHex[i]);
  }
  return diff == 0;
}

String nasUserKey(int slot) {
  return "u" + String(slot);
}

bool loadStoredNasUser(int slot, StoredNasUser &user) {
  user.valid = false;
  if (slot < 0 || slot >= MAX_NAS_USERS) return false;
  if (!userPrefs.begin("swusers", true)) return false;

  String key = nasUserKey(slot);
  String record = userPrefs.getString(key.c_str(), "");
  userPrefs.end();
  if (record.length() == 0) return false;

  user.username = fieldAt(record, 2);
  user.status = fieldAt(record, 1);
  user.saltHex = fieldAt(record, 3);
  user.passwordHashHex = fieldAt(record, 4);
  if (
    fieldAt(record, 0) != "U1" ||
    (user.status != "pending" && user.status != "active") ||
    !validUsername(user.username) ||
    !isHexString(user.saltHex, 32) ||
    !isHexString(user.passwordHashHex, 64) ||
    fieldAt(record, 5).length() > 0
  ) {
    return false;
  }

  user.valid = true;
  return true;
}

bool saveStoredNasUser(int slot, const StoredNasUser &user) {
  if (slot < 0 || slot >= MAX_NAS_USERS || !user.valid) return false;
  if (!userPrefs.begin("swusers", false)) return false;

  String key = nasUserKey(slot);
  String record = "U1|" + user.status + "|" + user.username + "|" +
                  user.saltHex + "|" + user.passwordHashHex;
  size_t written = userPrefs.putString(key.c_str(), record);
  userPrefs.end();
  return written > 0;
}

bool removeStoredNasUser(int slot) {
  if (slot < 0 || slot >= MAX_NAS_USERS) return false;
  if (!userPrefs.begin("swusers", false)) return false;
  String key = nasUserKey(slot);
  bool removed = userPrefs.remove(key.c_str());
  userPrefs.end();
  return removed;
}

int findStoredNasUser(const String &username, StoredNasUser &user) {
  for (int slot = 0; slot < MAX_NAS_USERS; slot++) {
    StoredNasUser candidate;
    if (loadStoredNasUser(slot, candidate) && candidate.username == username) {
      user = candidate;
      return slot;
    }
  }
  return -1;
}

int findFreeNasUserSlot() {
  for (int slot = 0; slot < MAX_NAS_USERS; slot++) {
    StoredNasUser candidate;
    if (!loadStoredNasUser(slot, candidate)) return slot;
  }
  return -1;
}

uint8_t countNasUsersWithStatus(const String &status) {
  uint8_t count = 0;
  for (int slot = 0; slot < MAX_NAS_USERS; slot++) {
    StoredNasUser user;
    if (loadStoredNasUser(slot, user) && user.status == status) count++;
  }
  return count;
}

bool parseIPv4(const String &text, IPAddress &result) {
  int a, b, c, d;

  if (
    sscanf(
      text.c_str(),
      "%d.%d.%d.%d",
      &a,
      &b,
      &c,
      &d
    ) != 4
  ) {
    return false;
  }

  if (
    a < 0 || a > 255 ||
    b < 0 || b > 255 ||
    c < 0 || c > 255 ||
    d < 0 || d > 255
  ) {
    return false;
  }

  result = IPAddress(a, b, c, d);
  return true;
}

// =====================================================
// Authentication
// =====================================================

String getRequestSessionToken() {
  String cookie = server.header("Cookie");
  const String key = "SWIFTWING_SESSION=";

  int start = cookie.indexOf(key);
  if (start < 0) {
    return "";
  }

  start += key.length();

  int end = cookie.indexOf(';', start);
  if (end < 0) {
    end = cookie.length();
  }

  String token = cookie.substring(start, end);
  token.trim();
  return token;
}

int findSessionSlot(const String &token) {
  if (token.length() == 0) {
    return -1;
  }

  for (int i = 0; i < MAX_SESSIONS; i++) {
    if (
      sessions[i].token.length() > 0 &&
      sessions[i].token == token
    ) {
      return i;
    }
  }

  return -1;
}

bool isAuthenticated() {
  return currentSessionSlot() >= 0;
}

int currentSessionSlot() {
  String token = getRequestSessionToken();
  int slot = findSessionSlot(token);
  if (slot >= 0) sessions[slot].lastSeen = millis();
  return slot;
}

bool isAdminAuthenticated() {
  int slot = currentSessionSlot();
  return slot >= 0 && sessions[slot].isAdmin;
}

String makeSessionToken() {
  char buf[33];

  snprintf(
    buf,
    sizeof(buf),
    "%08lx%08lx%08lx%08lx",
    (unsigned long)esp_random(),
    (unsigned long)esp_random(),
    (unsigned long)esp_random(),
    (unsigned long)esp_random()
  );

  return String(buf);
}

int allocateSessionSlot() {
  // Prefer a free slot first.
  for (int i = 0; i < MAX_SESSIONS; i++) {
    if (sessions[i].token.length() == 0) {
      return i;
    }
  }

  // If all 8 slots are occupied, replace the least recently used session.
  int oldestSlot = 0;
  unsigned long oldestSeen = sessions[0].lastSeen;

  for (int i = 1; i < MAX_SESSIONS; i++) {
    if ((long)(sessions[i].lastSeen - oldestSeen) < 0) {
      oldestSeen = sessions[i].lastSeen;
      oldestSlot = i;
    }
  }

  return oldestSlot;
}

String createSession(const String &username, bool isAdmin) {
  int slot = allocateSessionSlot();

  sessions[slot].token = makeSessionToken();
  sessions[slot].username = username;
  sessions[slot].isAdmin = isAdmin;
  sessions[slot].lastSeen = millis();

  return sessions[slot].token;
}

void clearSessionsForUser(const String &username) {
  for (int i = 0; i < MAX_SESSIONS; i++) {
    if (sessions[i].username == username && sessions[i].token.length() > 0) {
      sessions[i].token = "";
      sessions[i].username = "";
      sessions[i].isAdmin = false;
      sessions[i].lastSeen = 0;
    }
  }
}

void removeCurrentSession() {
  String token = getRequestSessionToken();
  int slot = findSessionSlot(token);

  if (slot >= 0) {
    sessions[slot].token = "";
    sessions[slot].username = "";
    sessions[slot].isAdmin = false;
    sessions[slot].lastSeen = 0;
  }
}

void redirectTo(const String &location) {
  server.sendHeader("Location", location);
  server.send(303, "text/plain", "");
}

void handleLoginPage() {
  static const uint8_t LOGIN_PAGE[] PROGMEM = {
  0x1F, 0x8B, 0x08, 0x00, 0x00, 0x00, 0x00, 0x00, 0x02, 0xFF, 0xDD, 0x7D, 0xDB, 0x92, 0xDB, 0xC8, 0xB5, 0xE5, 0xBB, 0xBE,
  0x02, 0x5D, 0x0A, 0x35, 0xC9, 0x3E, 0x20, 0x0B, 0x77, 0x80, 0xA4, 0xAA, 0xEC, 0x6A, 0xB5, 0xD4, 0x56, 0x4C, 0x4B, 0xAD,
  0x50, 0xA9, 0x6D, 0xF7, 0x71, 0x74, 0x4C, 0x80, 0x04, 0x58, 0x45, 0x8B, 0x37, 0x83, 0x64, 0x55, 0xD1, 0x14, 0x23, 0xCE,
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  0xBD, 0xE2, 0xE9, 0xF2, 0xC9, 0xFF, 0x05, 0x7A, 0x43, 0x64, 0x44, 0x98, 0x99, 0x00, 0x00,
};
  static const size_t LOGIN_PAGE_LEN = sizeof(LOGIN_PAGE);

  server.sendHeader("Cache-Control", "no-store, no-cache, must-revalidate, max-age=0");
  server.sendHeader("Pragma", "no-cache");
  server.sendHeader("Content-Encoding", "gzip");
  server.send_P(
    200,
    "text/html; charset=utf-8",
    (PGM_P)LOGIN_PAGE,
    LOGIN_PAGE_LEN
  );
}

void handleLogin() {
  if (
    !server.hasArg("username") ||
    !server.hasArg("password")
  ) {
    server.send(
      400,
      "text/plain",
      "Missing credentials"
    );

    return;
  }

  String username = normalizeUsername(server.arg("username"));
  String password = server.arg("password");
  String adminUsername = normalizeUsername(String(UI_USERNAME));
  bool authenticated = false;
  bool isAdmin = false;

  if (username == adminUsername && password == UI_PASSWORD) {
    authenticated = true;
    isAdmin = true;
  } else {
    StoredNasUser account;
    int accountSlot = findStoredNasUser(username, account);
    if (
      accountSlot >= 0 &&
      passwordMatches(password, account.saltHex, account.passwordHashHex)
    ) {
      if (account.status == "pending") {
        server.send(
          403,
          "text/plain; charset=utf-8",
          "Your account request is waiting for owner approval."
        );
        return;
      }
      authenticated = account.status == "active";
    }
  }

  if (!authenticated) {
    server.send(
      401,
      "text/plain; charset=utf-8",
      "Invalid username or password"
    );

    return;
  }

  String newSessionToken = createSession(username, isAdmin);

  server.sendHeader(
    "Set-Cookie",
    "SWIFTWING_SESSION=" +
    newSessionToken +
    "; Path=/; HttpOnly; SameSite=Lax"
  );

  redirectTo("/");
}

void sendAccountResponse(int statusCode, bool ok, const String &message) {
  String json = "{\"ok\":";
  json += ok ? "true" : "false";
  json += ",\"message\":\"" + jsonEscape(message) + "\"}";
  server.sendHeader("Cache-Control", "no-store");
  server.send(statusCode, "application/json; charset=utf-8", json);
}

void handleRegister() {
  if (
    !server.hasArg("username") ||
    !server.hasArg("password") ||
    !server.hasArg("confirmPassword")
  ) {
    sendAccountResponse(400, false, "Complete all account fields.");
    return;
  }

  String username = normalizeUsername(server.arg("username"));
  String password = server.arg("password");
  String confirmPassword = server.arg("confirmPassword");

  if (!validUsername(username)) {
    sendAccountResponse(400, false, "Use 3–24 letters, numbers, dots, hyphens, or underscores.");
    return;
  }

  if (username == normalizeUsername(String(UI_USERNAME))) {
    sendAccountResponse(409, false, "That username is reserved for the NAS owner.");
    return;
  }

  if (password.length() < 8 || password.length() > 64) {
    sendAccountResponse(400, false, "Choose a password between 8 and 64 characters.");
    return;
  }

  if (password != confirmPassword) {
    sendAccountResponse(400, false, "The passwords do not match.");
    return;
  }

  StoredNasUser existing;
  if (findStoredNasUser(username, existing) >= 0) {
    sendAccountResponse(409, false, "That username is already in use.");
    return;
  }

  if (countNasUsersWithStatus("pending") >= MAX_PENDING_NAS_USERS) {
    sendAccountResponse(409, false, "The approval queue is full. Please contact the NAS owner.");
    return;
  }

  int slot = findFreeNasUserSlot();
  if (slot < 0) {
    sendAccountResponse(409, false, "The NAS has reached its user account limit.");
    return;
  }

  StoredNasUser account;
  account.username = username;
  account.status = "pending";
  account.saltHex = makeRandomSaltHex();
  account.valid = derivePasswordHash(password, account.saltHex, account.passwordHashHex);
  if (!account.valid) {
    sendAccountResponse(500, false, "Could not secure the password. Please try again.");
    return;
  }

  if (!saveStoredNasUser(slot, account)) {
    sendAccountResponse(500, false, "Could not create the account. Please try again.");
    return;
  }

  sendAccountResponse(202, true, "Request submitted. You can sign in after the NAS owner approves it.");
}

void handleAccounts() {
  if (!isAdminAuthenticated()) {
    sendAccountResponse(403, false, "Owner access required.");
    return;
  }

  String json;
  json.reserve(1200);
  json = "{\"pending\":[";
  bool firstPending = true;
  for (int slot = 0; slot < MAX_NAS_USERS; slot++) {
    StoredNasUser account;
    if (!loadStoredNasUser(slot, account) || account.status != "pending") continue;
    if (!firstPending) json += ",";
    json += "{\"username\":\"" + jsonEscape(account.username) + "\"}";
    firstPending = false;
  }
  json += "],\"users\":[";
  bool firstActive = true;
  for (int slot = 0; slot < MAX_NAS_USERS; slot++) {
    StoredNasUser account;
    if (!loadStoredNasUser(slot, account) || account.status != "active") continue;
    if (!firstActive) json += ",";
    json += "{\"username\":\"" + jsonEscape(account.username) + "\"}";
    firstActive = false;
  }
  json += "]}";

  server.sendHeader("Cache-Control", "no-store");
  server.send(200, "application/json; charset=utf-8", json);
}

void handleAccountReview() {
  if (!isAdminAuthenticated()) {
    sendAccountResponse(403, false, "Owner access required.");
    return;
  }

  if (!server.hasArg("username") || !server.hasArg("action")) {
    sendAccountResponse(400, false, "Missing account or action.");
    return;
  }

  String username = normalizeUsername(server.arg("username"));
  String action = server.arg("action");
  StoredNasUser account;
  int slot = findStoredNasUser(username, account);
  if (slot < 0) {
    sendAccountResponse(404, false, "User account was not found.");
    return;
  }

  if (action == "approve") {
    if (account.status != "pending") {
      sendAccountResponse(409, false, "Only pending requests can be approved.");
      return;
    }
    account.status = "active";
    if (!saveStoredNasUser(slot, account)) {
      sendAccountResponse(500, false, "Could not approve this account request.");
      return;
    }
    sendAccountResponse(200, true, "Account approved. The user can now sign in.");
    return;
  }

  if (action == "reject") {
    if (account.status != "pending") {
      sendAccountResponse(409, false, "Only pending requests can be rejected.");
      return;
    }
    clearSessionsForUser(username);
    if (!removeStoredNasUser(slot)) {
      sendAccountResponse(500, false, "Could not reject this account request.");
      return;
    }
    sendAccountResponse(200, true, "Request rejected and removed.");
    return;
  }

  if (action != "revoke" || account.status != "active") {
    sendAccountResponse(400, false, "Choose approve, reject or revoke for the selected account.");
    return;
  }

  clearSessionsForUser(username);
  if (!removeStoredNasUser(slot)) {
    sendAccountResponse(500, false, "Could not remove this account.");
    return;
  }
  sendAccountResponse(200, true, "Account access revoked.");
}

void handleLogout() {
  removeCurrentSession();

  server.sendHeader(
    "Set-Cookie",
    "SWIFTWING_SESSION=deleted; Path=/; Max-Age=0; HttpOnly; SameSite=Lax"
  );

  redirectTo("/");
}

// =====================================================
// Discovery
// =====================================================

void sendStorageDiscovery() {
  storageUDP.beginPacket(
    IPAddress(255, 255, 255, 255),
    STORAGE_DISCOVERY_PORT
  );

  storageUDP.print(
    "SWIFTWING_DISCOVER|MASTER"
  );

  storageUDP.endPacket();
}

void processStorageReplies() {
  int packetSize = storageUDP.parsePacket();

  while (packetSize) {
    char buffer[256];

    int len = storageUDP.read(
      buffer,
      sizeof(buffer) - 1
    );

    if (len > 0) {
      buffer[len] = '\0';
    }

    String msg(buffer);

    // SWIFTWING_STORAGE|NODE1|ip|port|ready|total|used|free|uptime
    if (msg.startsWith("SWIFTWING_STORAGE|")) {
      String id = fieldAt(msg, 1);

      IPAddress reportedIP;

      if (!parseIPv4(fieldAt(msg, 2), reportedIP)) {
        reportedIP = storageUDP.remoteIP();
      }

      uint16_t port = (uint16_t)fieldAt(msg, 3).toInt();
      if (port == 0) {
        port = 80;
      }

      bool storageReady = fieldAt(msg, 4).toInt() == 1;

      uint64_t totalBytes = strtoull(
        fieldAt(msg, 5).c_str(),
        nullptr,
        10
      );

      uint64_t usedBytes = strtoull(
        fieldAt(msg, 6).c_str(),
        nullptr,
        10
      );

      uint64_t freeBytes = strtoull(
        fieldAt(msg, 7).c_str(),
        nullptr,
        10
      );

      uint32_t uptimeSeconds =
        fieldAt(msg, 8).toInt();

      if (id == "NODE1") {
        node1IP = reportedIP;
        node1Port = port;
        node1StorageReady = storageReady;
        node1TotalBytes = totalBytes;
        node1UsedBytes = usedBytes;
        node1FreeBytes = freeBytes;
        node1UptimeSeconds = uptimeSeconds;
        node1LastSeen = millis();
        node1Online = true;
      }

      else if (id == "NODE2") {
        node2IP = reportedIP;
        node2Port = port;
        node2StorageReady = storageReady;
        node2TotalBytes = totalBytes;
        node2UsedBytes = usedBytes;
        node2FreeBytes = freeBytes;
        node2UptimeSeconds = uptimeSeconds;
        node2LastSeen = millis();
        node2Online = true;
      }
    }

    packetSize = storageUDP.parsePacket();
  }

  unsigned long now = millis();

  if (
    node1Online &&
    now - node1LastSeen > NODE_TIMEOUT_MS
  ) {
    node1Online = false;
  }

  if (
    node2Online &&
    now - node2LastSeen > NODE_TIMEOUT_MS
  ) {
    node2Online = false;
  }
}

IPAddress subnetBroadcastIP() {
  IPAddress ip = WiFi.localIP();
  IPAddress mask = WiFi.subnetMask();

  return IPAddress(
    ip[0] | (uint8_t)(~mask[0]),
    ip[1] | (uint8_t)(~mask[1]),
    ip[2] | (uint8_t)(~mask[2]),
    ip[3] | (uint8_t)(~mask[3])
  );
}

void sendMasterAnnouncementTo(
  IPAddress targetIP,
  uint16_t targetPort
) {
  String msg =
    "SWIFTWING_MASTER|" +
    WiFi.localIP().toString() +
    "|" +
    String(millis() / 1000UL);

  masterAnnounceUDP.beginPacket(
    targetIP,
    targetPort
  );

  masterAnnounceUDP.print(msg);
  masterAnnounceUDP.endPacket();
}

void sendMasterAnnouncement() {
  if (
    WiFi.status() !=
    WL_CONNECTED
  ) {
    return;
  }

  // Traditional limited broadcast.
  sendMasterAnnouncementTo(
    IPAddress(255, 255, 255, 255),
    MASTER_ANNOUNCE_PORT
  );

  // Subnet-directed broadcast, e.g. 192.168.0.255.
  IPAddress subnetBroadcast =
    subnetBroadcastIP();

  if (
    subnetBroadcast !=
    IPAddress(255, 255, 255, 255)
  ) {
    sendMasterAnnouncementTo(
      subnetBroadcast,
      MASTER_ANNOUNCE_PORT
    );
  }
}

void processMasterDiscoveryRequests() {
  int packetSize =
    masterAnnounceUDP.parsePacket();

  while (packetSize) {
    char buffer[160];

    int len =
      masterAnnounceUDP.read(
        buffer,
        sizeof(buffer) - 1
      );

    if (len > 0) {
      buffer[len] = '\0';
    }

    String msg(buffer);

    if (
      msg.startsWith(
        "SWIFTWING_FIND_MASTER|"
      )
    ) {
      // Reply directly to the requesting device.
      sendMasterAnnouncementTo(
        masterAnnounceUDP.remoteIP(),
        masterAnnounceUDP.remotePort()
      );

      Serial.print(
        "Master discovery reply -> "
      );
      Serial.print(
        masterAnnounceUDP.remoteIP()
      );
      Serial.print(":");
      Serial.println(
        masterAnnounceUDP.remotePort()
      );
    }

    packetSize =
      masterAnnounceUDP.parsePacket();
  }
}

void processDNSStatus() {
  int packetSize =
    dnsStatusUDP.parsePacket();

  while (packetSize) {
    char buffer[160];

    int len =
      dnsStatusUDP.read(
        buffer,
        sizeof(buffer) - 1
      );

    if (len > 0) {
      buffer[len] = '\0';
    }

    String msg(buffer);

    if (
      msg.startsWith(
        "SWIFTWING_DNS|C3|"
      )
    ) {
      IPAddress ip;

      if (
        parseIPv4(
          fieldAt(msg, 2),
          ip
        )
      ) {
        c3IP = ip;
      } else {
        c3IP =
          dnsStatusUDP.remoteIP();
      }

      c3Uptime =
        fieldAt(msg, 3).toInt();

      c3LastSeen =
        millis();

      c3Online =
        true;
    }

    packetSize =
      dnsStatusUDP.parsePacket();
  }

  if (
    c3Online &&
    millis() - c3LastSeen >
    SERVICE_TIMEOUT_MS
  ) {
    c3Online = false;
  }
}

void processMonitorStatus() {
  int packetSize =
    monitorStatusUDP.parsePacket();

  while (packetSize) {
    char buffer[180];

    int len =
      monitorStatusUDP.read(
        buffer,
        sizeof(buffer) - 1
      );

    if (len > 0) {
      buffer[len] = '\0';
    }

    String msg(buffer);

    String monitorType = fieldAt(msg, 1);

    if (
      msg.startsWith("SWIFTWING_MONITOR|") &&
      (monitorType == "ESP32" || monitorType == "ESP8266")
    ) {
      IPAddress ip;

      if (
        parseIPv4(
          fieldAt(msg, 2),
          ip
        )
      ) {
        monitorIP = ip;
      } else {
        monitorIP =
          monitorStatusUDP.remoteIP();
      }

      monitorUptime =
        fieldAt(msg, 3).toInt();

      monitorRSSI =
        fieldAt(msg, 4).toInt();

      monitorFanSupported = fieldAt(msg, 5) == "FAN1";
      if (monitorFanSupported) {
        int targetPercent = fieldAt(msg, 6).toInt();
        int outputPercent = fieldAt(msg, 7).toInt();
        monitorFanPercent = (uint8_t)constrain(targetPercent, 0, 100);
        monitorFanOutputPercent = (uint8_t)constrain(outputPercent, 0, 100);
      } else {
        monitorFanPercent = 0;
        monitorFanOutputPercent = 0;
      }

      monitorLastSeen =
        millis();

      monitorOnline =
        true;

      monitorBoard =
        monitorType;
    }

    packetSize =
      monitorStatusUDP.parsePacket();
  }

  if (
    monitorOnline &&
    millis() - monitorLastSeen >
    SERVICE_TIMEOUT_MS
  ) {
    monitorOnline = false;
    monitorFanSupported = false;
  }
}

// =====================================================
// JSON State API
// =====================================================

String node1Json() {
  String s = "{";

  s += "\"id\":\"" + jsonEscape(node1Id) + "\",";
  s += "\"label\":\"" + jsonEscape(node1Label) + "\",";
  s += "\"online\":" + String(node1Online ? "true" : "false") + ",";
  s += "\"storageReady\":" + String(node1StorageReady ? "true" : "false") + ",";
  s += "\"ip\":\"" + node1IP.toString() + "\",";
  s += "\"port\":" + String(node1Port) + ",";
  s += "\"total\":" + uint64ToString(node1TotalBytes) + ",";
  s += "\"used\":" + uint64ToString(node1UsedBytes) + ",";
  s += "\"free\":" + uint64ToString(node1FreeBytes) + ",";
  s += "\"uptime\":" + String(node1UptimeSeconds);

  s += "}";
  return s;
}

String node2Json() {
  String s = "{";

  s += "\"id\":\"" + jsonEscape(node2Id) + "\",";
  s += "\"label\":\"" + jsonEscape(node2Label) + "\",";
  s += "\"online\":" + String(node2Online ? "true" : "false") + ",";
  s += "\"storageReady\":" + String(node2StorageReady ? "true" : "false") + ",";
  s += "\"ip\":\"" + node2IP.toString() + "\",";
  s += "\"port\":" + String(node2Port) + ",";
  s += "\"total\":" + uint64ToString(node2TotalBytes) + ",";
  s += "\"used\":" + uint64ToString(node2UsedBytes) + ",";
  s += "\"free\":" + uint64ToString(node2FreeBytes) + ",";
  s += "\"uptime\":" + String(node2UptimeSeconds);

  s += "}";
  return s;
}

void handleState() {
  int sessionSlot = currentSessionSlot();
  if (sessionSlot < 0) {
    server.send(
      401,
      "application/json",
      "{\"error\":\"unauthorized\"}"
    );

    return;
  }

  String json;
  json.reserve(1600);

  json = "{";

  json +=
    "\"currentUser\":\"" +
    jsonEscape(sessions[sessionSlot].username) +
    "\",";

  json +=
    "\"isAdmin\":" +
    String(sessions[sessionSlot].isAdmin ? "true" : "false") +
    ",";

  json +=
    "\"apiKey\":\"" +
    jsonEscape(
      String(NODE_API_KEY)
    ) +
    "\",";

  json +=
    "\"domain\":\"" +
    jsonEscape(
      String(NAS_DOMAIN)
    ) +
    "\",";

  json +=
    "\"nodes\":{";

  json +=
    "\"NODE1\":" +
    node1Json() +
    ",";

  json +=
    "\"NODE2\":" +
    node2Json();

  json += "},";

  json +=
    "\"services\":{";

  json +=
    "\"master\":{";

  json +=
    "\"label\":\"Master\",";

  json +=
    "\"detail\":\"Control / UI\",";

  json +=
    "\"online\":true,";

  json +=
    "\"ip\":\"" +
    WiFi.localIP().toString() +
    "\",";

  json +=
    "\"uptime\":" +
    String(
      millis() / 1000UL
    );

  json += "},";

  json +=
    "\"dns\":{";

  json +=
    "\"label\":\"C3 DNS\",";

  json +=
    "\"detail\":\"Local DNS\",";

  json +=
    "\"online\":" +
    String(
      c3Online ?
      "true" :
      "false"
    ) +
    ",";

  json +=
    "\"ip\":\"" +
    c3IP.toString() +
    "\",";

  json +=
    "\"uptime\":" +
    String(c3Uptime);

  json += "},";

  json +=
    "\"monitor\":{";

  json +=
    "\"label\":\"" +
    monitorBoard +
    " Monitor\",";

  json +=
    "\"detail\":\"Monitor / OLED\",";

  json +=
    "\"online\":" +
    String(
      monitorOnline ?
      "true" :
      "false"
    ) +
    ",";

  json +=
    "\"ip\":\"" +
    monitorIP.toString() +
    "\",";

  json +=
    "\"uptime\":" +
    String(
      monitorUptime
    ) +
    ",";

  json +=
    "\"rssi\":" +
    String(
      monitorRSSI
    ) +
    ",";

  json +=
    "\"fanSupported\":" +
    String(monitorFanSupported ? "true" : "false") +
    ",";

  json +=
    "\"fanPercent\":" +
    String(monitorFanPercent) +
    ",";

  json +=
    "\"fanOutputPercent\":" +
    String(monitorFanOutputPercent);

  json += "}";

  json += "}";

  json += "}";

  server.sendHeader(
    "Cache-Control",
    "no-store"
  );

  server.send(
    200,
    "application/json; charset=utf-8",
    json
  );
}

void handleFanControl() {
  if (!isAuthenticated()) {
    server.send(401, "application/json", "{\"error\":\"unauthorized\"}");
    return;
  }

  if (!isAdminAuthenticated()) {
    server.send(403, "application/json", "{\"error\":\"owner account required\"}");
    return;
  }

  if (!server.hasArg("percent")) {
    server.send(400, "application/json", "{\"error\":\"missing percent\"}");
    return;
  }

  String rawPercent = server.arg("percent");
  rawPercent.trim();
  char* end = nullptr;
  long percent = strtol(rawPercent.c_str(), &end, 10);
  if (rawPercent.length() == 0 || end == rawPercent.c_str() || *end != '\0' || percent < 0 || percent > 100) {
    server.send(400, "application/json", "{\"error\":\"percent must be 0 to 100\"}");
    return;
  }

  if (!monitorOnline || !monitorFanSupported) {
    server.send(409, "application/json", "{\"error\":\"fan-capable ESP32 Monitor is offline\"}");
    return;
  }

  monitorStatusUDP.beginPacket(monitorIP, MONITOR_FAN_CONTROL_PORT);
  monitorStatusUDP.print(String("SWIFTWING_FAN|V1|") + String(percent));
  if (monitorStatusUDP.endPacket() != 1) {
    server.send(502, "application/json", "{\"error\":\"fan command could not be sent\"}");
    return;
  }

  server.sendHeader("Cache-Control", "no-store");
  server.send(202, "application/json", String("{\"ok\":true,\"requested\":") + String(percent) + "}");
}

// =====================================================
// Web Routes
// =====================================================

void handleRoot() {
  if (provisioningMode && WiFi.status() != WL_CONNECTED) {
    server.sendHeader("Cache-Control", "no-store, no-cache, must-revalidate, max-age=0");
    server.sendHeader("Content-Encoding", "gzip");
    server.send_P(200, "text/html; charset=utf-8", (PGM_P)WIFI_SETUP_PAGE, WIFI_SETUP_PAGE_LEN);
    return;
  }

  if (!isAuthenticated()) {
    handleLoginPage();
    return;
  }

  server.sendHeader("Cache-Control", "no-store, no-cache, must-revalidate, max-age=0");
  server.sendHeader("Pragma", "no-cache");
  server.sendHeader("Expires", "0");

  server.sendHeader("Content-Encoding", "gzip");
  server.send_P(
    200,
    "text/html; charset=utf-8",
    (PGM_P)MAIN_PAGE,
    MAIN_PAGE_LEN
  );
}

void handleStatusPage() {
  if (!isAuthenticated()) {
    redirectTo("/");
    return;
  }

  server.sendHeader("Content-Encoding", "gzip");
  server.send_P(
    200,
    "text/html; charset=utf-8",
    (PGM_P)STATUS_PAGE,
    STATUS_PAGE_LEN
  );
}

// =====================================================
// WiFi
// =====================================================

// Managed by the Swiftwing Wi-Fi block near the top of this file.

// =====================================================
// Setup / Loop
// =====================================================

void setup() {
  // The control/UI board does not handle file data. 160 MHz keeps Wi-Fi and
  // the web UI responsive while reducing the CPU's active power from 240 MHz.
  bool cpuClockReduced = setCpuFrequencyMhz(160);
  Serial.begin(115200);

  if (!cpuClockReduced) {
    Serial.println("Master CPU clock reduction unavailable; using board default");
  }

  delay(500);
  connectWiFi();

  wifiSyncUDP.begin(WIFI_SYNC_LOCAL_PORT);

  storageUDP.begin(
    STORAGE_DISCOVERY_PORT
  );

  masterAnnounceUDP.begin(
    MASTER_LOCAL_PORT
  );

  dnsStatusUDP.begin(
    DNS_STATUS_PORT
  );

  monitorStatusUDP.begin(
    MONITOR_STATUS_PORT
  );

  const char* headerKeys[] = {
    "Cookie"
  };

  server.collectHeaders(
    headerKeys,
    1
  );

  server.on(
    "/",
    HTTP_GET,
    handleRoot
  );

  server.on(
    "/status",
    HTTP_GET,
    handleStatusPage
  );

  server.on(
    "/api/state",
    HTTP_GET,
    handleState
  );

  server.on(
    "/api/fan",
    HTTP_POST,
    handleFanControl
  );

  server.on(
    "/login",
    HTTP_GET,
    handleLoginPage
  );

  server.on(
    "/login",
    HTTP_POST,
    handleLogin
  );

  server.on(
    "/register",
    HTTP_POST,
    handleRegister
  );

  server.on(
    "/api/accounts",
    HTTP_GET,
    handleAccounts
  );

  server.on(
    "/api/accounts/review",
    HTTP_POST,
    handleAccountReview
  );

  server.on(
    "/logout",
    HTTP_GET,
    handleLogout
  );

  server.on(
    "/ui-version",
    HTTP_GET,
    []() {
      server.sendHeader("Cache-Control", "no-store, no-cache, must-revalidate, max-age=0");
      server.send(200, "text/plain; charset=utf-8", UI_BUILD);
    }
  );

  server.on(
    "/wifi",
    HTTP_GET,
    []() {
      if (!wifiAdminAllowed()) { redirectTo("/"); return; }
      server.sendHeader("Cache-Control", "no-store, no-cache, must-revalidate, max-age=0");
      server.sendHeader("Content-Encoding", "gzip");
      server.send_P(200, "text/html; charset=utf-8", (PGM_P)WIFI_SETUP_PAGE, WIFI_SETUP_PAGE_LEN);
    }
  );

  server.on(
    "/api/wifi/status",
    HTTP_GET,
    handleWiFiStatus
  );

  server.on(
    "/api/wifi/scan",
    HTTP_GET,
    handleWiFiScan
  );

  server.on(
    "/api/wifi/apply",
    HTTP_POST,
    handleWiFiApply
  );

  server.on(
    "/api/wifi/bootstrap",
    HTTP_GET,
    handleWiFiBootstrap
  );

  server.onNotFound(
    []() {
      if (!isAuthenticated()) {
        redirectTo("/");
        return;
      }

      server.send(
        404,
        "text/plain",
        "Not found"
      );
    }
  );

  server.begin();

  sendStorageDiscovery();

  sendMasterAnnouncement();

  lastDiscovery =
    millis();

  lastMasterAnnouncement =
    millis();

  Serial.println(
    "Swiftwing Master V1.3 ONLINE"
  );

  Serial.print(
    "Files: http://"
  );

  Serial.println(
    WiFi.localIP()
  );

  Serial.print(
    "Status: http://"
  );

  Serial.print(
    WiFi.localIP()
  );

  Serial.println(
    "/status"
  );
}

void loop() {
  server.handleClient();

  processMasterDiscoveryRequests();
  processStorageReplies();

  processDNSStatus();

  processMonitorStatus();

  maintainMasterWiFi();

  if (wifiRestartAt && (long)(millis() - wifiRestartAt) >= 0) {
    ESP.restart();
  }

  unsigned long now =
    millis();

  if (
    now - lastDiscovery >=
    DISCOVERY_INTERVAL_MS
  ) {
    lastDiscovery =
      now;

    sendStorageDiscovery();
  }

  if (
    now - lastMasterAnnouncement >=
    MASTER_ANNOUNCE_MS
  ) {
    lastMasterAnnouncement =
      now;

    sendMasterAnnouncement();
  }

  // Give the Wi-Fi task more idle time while keeping UI/UDP polling responsive.
  delay(5);
}
